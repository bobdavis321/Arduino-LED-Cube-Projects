// 8x8x8 kit retrofitted with arduino
// uses some ports in parallel mode
// PORTD = D0 to D7 Data port to latches
// PORTB = Bits 0, 1 and 2 or D8, D9, D10 are latch select
// PORTB = Bits 4 and 5 or D12, D13 are level select 6 and 7
// PORTC = Level select 0-5
//int latch0 = 8;
//int latch1 = 9;
//int latch2 = 10;

int level = 0;
int shift = 0;
int i;
//unsigned char cube[8][8]=;
byte cube[][8]= {
// there are eight bytes of eight LED’s per layer.
 {0x80, 0x40, 0x20, 0x10, 0x08, 0x04, 0x02, 0x01},
 {0x40, 0x20, 0x10, 0x08, 0x04, 0x02, 0x01, 0x80},
 {0x20, 0x10, 0x08, 0x04, 0x02, 0x01, 0x80, 0x40},
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 {0x01, 0x80, 0x40, 0x20, 0x10, 0x08, 0x04, 0x02},
 };

// set all pins to output
void setup(){
  for(i=0; i<20; i++) pinMode(i, OUTPUT);
  }

void loop(){
  for (level=0; level<8; level++) {
    // turn all level selects off
    PORTC = 0x00;
    digitalWrite(12, LOW);
    digitalWrite(13, LOW);
    // load latches for current layer
    for (i=0; i<8; i++) {
      // load data
      PORTD = cube[level+shift][i];
      // PORTD = 0xFF; // all on test
      // Select next latch
      PORTB = (i);
    }
  
  // Select the level and turn it on
  if (level == 0) PORTC = (0x01);
  if (level == 1) PORTC = (0x02);
  if (level == 2) PORTC = (0x04);
  if (level == 3) PORTC = (0x08);
  if (level == 4) PORTC = (0x10);
  if (level == 5) PORTC = (0x20);
  if (level == 6) digitalWrite(12, HIGH);
  if (level == 7) {
    digitalWrite(13, HIGH);
    shift = shift+1;
    if (shift > 8) shift=0;
  }
  delay(1);
  } 
}


