// 8x8x8 kit retrofitted with arduino slice demo
// uses some ports in parallel mode
// PORTD = D0 to D7 Data port to latches
// PORTB = D8, D9, D10 or bits 0, 1 and 2 are latch select
// PORTB = D12, D13 or bits 4 and 5 are level select 6 and 7
// PORTC = A0 to A5 are level select 0-5
int cycle = 0;
int level = 0;
int shift = 0;
int latch = 0;
int i;
//unsigned char cube[8][8]=;
byte cube[][8]= {
// there are eight bytes of eight LED’s per layer.
 {0x80, 0x40, 0x20, 0x10, 0x08, 0x04, 0x02, 0x01},
 {0x40, 0x20, 0x10, 0x08, 0x04, 0x02, 0x01, 0x80},
 {0x20, 0x10, 0x08, 0x04, 0x02, 0x01, 0x80, 0x40},
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 {0x01, 0x80, 0x40, 0x20, 0x10, 0x08, 0x04, 0x02},
 };

// set all pins to output mode
void setup(){
  for(i=0; i<20; i++) pinMode(i, OUTPUT);
  }

void loop(){
  for (level=0; level<8; level++) {
    // turn all level selects off
    PORTC = 0x00;
    digitalWrite(12, LOW);
    digitalWrite(13, LOW);
    // load latches for current layer
    for (latch=0; latch<8; latch++) {
      // load data
      PORTD = cube[level+shift][latch];
      // PORTD = 0xFF; // all LED's on test
      // Select next latch
      PORTB = (latch);
    }
  
  // Select the level and turn it on
  if (level == 0) digitalWrite(14, HIGH);
  if (level == 1) digitalWrite(15, HIGH);
  if (level == 2) digitalWrite(16, HIGH);
  if (level == 3) digitalWrite(17, HIGH);
  if (level == 4) digitalWrite(18, HIGH);
  if (level == 5) digitalWrite(19, HIGH);
  if (level == 6) digitalWrite(12, HIGH);
  if (level == 7) {
    digitalWrite(13, HIGH);
    cycle = cycle+1;
    }
  // rotate one position every 20 cycles
  if (cycle > 20) {
    cycle = 0;
    shift = shift+1;
  }
  if (shift > 7) shift = 0;
  delay(2);
  } 
}


